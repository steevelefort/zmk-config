## zmk-workspace/build/cradio_left/Kconfig/Kconfig.shield.defconfig
```kconfig
osource "/workspace/zmk/app/module/boards/shields/*/Kconfig.defconfig"
osource "/workspace/zmk/app/boards/shields/*/Kconfig.defconfig"
```

## zmk-workspace/build/cradio_left/Kconfig/arch/Kconfig
```kconfig
# Load Zephyr Arch Kconfig descriptions.
osource "/workspace/zephyr/arch/x86/Kconfig"
osource "/workspace/zephyr/arch/xtensa/Kconfig"
osource "/workspace/zephyr/arch/sparc/Kconfig"
osource "/workspace/zephyr/arch/riscv/Kconfig"
osource "/workspace/zephyr/arch/posix/Kconfig"
osource "/workspace/zephyr/arch/nios2/Kconfig"
osource "/workspace/zephyr/arch/mips/Kconfig"
osource "/workspace/zephyr/arch/arm64/Kconfig"
osource "/workspace/zephyr/arch/arm/Kconfig"
osource "/workspace/zephyr/arch/arc/Kconfig"
```

## zmk-workspace/build/cradio_left/Kconfig/boards/Kconfig
```kconfig
# Load Zephyr board Kconfig descriptions.
osource "/workspace/zmk/app/module/boards/nicekeyboards/nice_nano/Kconfig"
osource "/workspace/zmk/app/boards/nicekeyboards/nice_nano/Kconfig"
```

## zmk-workspace/build/cradio_left/Kconfig/boards/Kconfig.defconfig
```kconfig
# Load Zephyr board defconfig descriptions.
osource "/workspace/zmk/app/module/boards/nicekeyboards/nice_nano/Kconfig.defconfig"
osource "/workspace/zmk/app/boards/nicekeyboards/nice_nano/Kconfig.defconfig"
```

## zmk-workspace/build/cradio_left/Kconfig/boards/Kconfig.sysbuild
```kconfig
# Load Sysbuild board Kconfig descriptions.
osource "/workspace/zmk/app/module/boards/nicekeyboards/nice_nano/Kconfig.sysbuild"
osource "/workspace/zmk/app/boards/nicekeyboards/nice_nano/Kconfig.sysbuild"
```

## zmk-workspace/build/cradio_right/Kconfig/Kconfig.modules
```kconfig
config ZEPHYR_HAL_STM32_MODULE
	bool
	default y

config ZEPHYR_HAL_STM32_MODULE_BLOBS
	bool
menu "lvgl (/workspace/modules/lib/gui/lvgl)"
osource "/workspace/modules/lib/gui/lvgl/zephyr/Kconfig"
config ZEPHYR_LVGL_MODULE
	bool
	default y
endmenu
config ZEPHYR_ZMK_STUDIO_MESSAGES_MODULE
	bool
	default y
menu "canopennode (/workspace/modules/lib/canopennode)"
osource "$(ZEPHYR_CANOPENNODE_KCONFIG)"
config ZEPHYR_CANOPENNODE_MODULE
	bool
	default y
endmenu
menu "chre (/workspace/modules/lib/chre)"
osource "/workspace/modules/lib/chre/platform/zephyr/Kconfig"
config ZEPHYR_CHRE_MODULE
	bool
	default y
endmenu
menu "lz4 (/workspace/modules/lib/lz4)"
osource "$(ZEPHYR_LZ4_KCONFIG)"
config ZEPHYR_LZ4_MODULE
	bool
	default y
endmenu
menu "nanopb (/workspace/modules/lib/nanopb)"
osource "$(ZEPHYR_NANOPB_KCONFIG)"
config ZEPHYR_NANOPB_MODULE
	bool
	default y
endmenu
config ZEPHYR_PSA_ARCH_TESTS_MODULE
	bool
	default y
menu "sof (/workspace/modules/audio/sof)"
osource "/workspace/modules/audio/sof/zephyr/Kconfig"
config ZEPHYR_SOF_MODULE
	bool
	default y
endmenu
config ZEPHYR_TF_M_TESTS_MODULE
	bool
	default y
menu "tflite-micro (/workspace/optional/modules/lib/tflite-micro)"
osource "$(ZEPHYR_TFLITE_MICRO_KCONFIG)"
config ZEPHYR_TFLITE_MICRO_MODULE
	bool
	default y
endmenu
menu "thrift (/workspace/optional/modules/lib/thrift)"
osource "$(ZEPHYR_THRIFT_KCONFIG)"
config ZEPHYR_THRIFT_MODULE
	bool
	default y
endmenu
menu "lang-rust (/workspace/modules/lang/rust)"
osource "/workspace/modules/lang/rust/Kconfig"
config ZEPHYR_LANG_RUST_MODULE
	bool
	default y
endmenu
menu "zscilib (/workspace/modules/lib/zscilib)"
osource "/workspace/modules/lib/zscilib/Kconfig.zscilib"
config ZEPHYR_ZSCILIB_MODULE
	bool
	default y
endmenu
menu "acpica (/workspace/modules/lib/acpica)"
osource "$(ZEPHYR_ACPICA_KCONFIG)"
config ZEPHYR_ACPICA_MODULE
	bool
	default y
endmenu
menu "cmsis (/workspace/modules/hal/cmsis)"
osource "$(ZEPHYR_CMSIS_KCONFIG)"
config ZEPHYR_CMSIS_MODULE
	bool
	default y
endmenu
menu "cmsis-dsp (/workspace/modules/lib/cmsis-dsp)"
osource "$(ZEPHYR_CMSIS_DSP_KCONFIG)"
config ZEPHYR_CMSIS_DSP_MODULE
	bool
	default y
endmenu
menu "cmsis-nn (/workspace/modules/lib/cmsis-nn)"
osource "$(ZEPHYR_CMSIS_NN_KCONFIG)"
config ZEPHYR_CMSIS_NN_MODULE
	bool
	default y
endmenu
menu "fatfs (/workspace/modules/fs/fatfs)"
osource "$(ZEPHYR_FATFS_KCONFIG)"
config ZEPHYR_FATFS_MODULE
	bool
	default y
endmenu
config ZEPHYR_ADI_MODULE
	bool
	default y
menu "hal_ambiq (/workspace/modules/hal/ambiq)"
osource "$(ZEPHYR_HAL_AMBIQ_KCONFIG)"
config ZEPHYR_HAL_AMBIQ_MODULE
	bool
	default y
endmenu
config ZEPHYR_ATMEL_MODULE
	bool
	default y
menu "hal_espressif (/workspace/modules/hal/espressif)"
osource "/workspace/modules/hal/espressif/zephyr/Kconfig"
config ZEPHYR_HAL_ESPRESSIF_MODULE
	bool
	default y

config ZEPHYR_HAL_ESPRESSIF_MODULE_BLOBS
	bool
endmenu
menu "hal_ethos_u (/workspace/modules/hal/ethos_u)"
osource "$(ZEPHYR_HAL_ETHOS_U_KCONFIG)"
config ZEPHYR_HAL_ETHOS_U_MODULE
	bool
	default y
endmenu
menu "hal_gigadevice (/workspace/modules/hal/gigadevice)"
osource "$(ZEPHYR_HAL_GIGADEVICE_KCONFIG)"
config ZEPHYR_HAL_GIGADEVICE_MODULE
	bool
	default y
endmenu
menu "hal_intel (/workspace/modules/hal/intel)"
osource "/workspace/modules/hal/intel/zephyr/Kconfig"
config ZEPHYR_HAL_INTEL_MODULE
	bool
	default y
endmenu
menu "hal_nordic (/workspace/modules/hal/nordic)"
osource "$(ZEPHYR_HAL_NORDIC_KCONFIG)"
config ZEPHYR_HAL_NORDIC_MODULE
	bool
	default y

config ZEPHYR_HAL_NORDIC_MODULE_BLOBS
	bool
endmenu
config ZEPHYR_NUVOTON_MODULE
	bool
	default y
config ZEPHYR_QUICKLOGIC_MODULE
	bool
	default y
config ZEPHYR_HAL_RENESAS_MODULE
	bool
	default y

config ZEPHYR_HAL_RENESAS_MODULE_BLOBS
	bool
menu "hal_rpi_pico (/workspace/modules/hal/rpi_pico)"
osource "$(ZEPHYR_HAL_RPI_PICO_KCONFIG)"
config ZEPHYR_HAL_RPI_PICO_MODULE
	bool
	default y
endmenu
menu "hal_silabs (/workspace/modules/hal/silabs)"
osource "$(ZEPHYR_HAL_SILABS_KCONFIG)"
config ZEPHYR_HAL_SILABS_MODULE
	bool
	default y

config ZEPHYR_HAL_SILABS_MODULE_BLOBS
	bool
endmenu
menu "hal_tdk (/workspace/modules/hal/tdk)"
osource "$(ZEPHYR_HAL_TDK_KCONFIG)"
config ZEPHYR_HAL_TDK_MODULE
	bool
	default y
endmenu
menu "hal_telink (/workspace/modules/hal/telink)"
osource "/workspace/modules/hal/telink/Kconfig"
config ZEPHYR_HAL_TELINK_MODULE
	bool
	default y
endmenu
menu "hal_wch (/workspace/modules/hal/wch)"
osource "$(ZEPHYR_HAL_WCH_KCONFIG)"
config ZEPHYR_HAL_WCH_MODULE
	bool
	default y
endmenu
config ZEPHYR_HAL_WURTHELEKTRONIK_MODULE
	bool
	default y
menu "hostap (/workspace/modules/lib/hostap)"
osource "$(ZEPHYR_HOSTAP_KCONFIG)"
config ZEPHYR_HOSTAP_MODULE
	bool
	default y
endmenu
menu "liblc3 (/workspace/modules/lib/liblc3)"
osource "$(ZEPHYR_LIBLC3_KCONFIG)"
config ZEPHYR_LIBLC3_MODULE
	bool
	default y
endmenu
config ZEPHYR_LIBMCTP_MODULE
	bool
	default y
config ZEPHYR_LIBMETAL_MODULE
	bool
	default y
menu "littlefs (/workspace/modules/fs/littlefs)"
osource "$(ZEPHYR_LITTLEFS_KCONFIG)"
config ZEPHYR_LITTLEFS_MODULE
	bool
	default y
endmenu
menu "mbedtls (/workspace/modules/crypto/mbedtls)"
osource "$(ZEPHYR_MBEDTLS_KCONFIG)"
config ZEPHYR_MBEDTLS_MODULE
	bool
	default y
endmenu
config ZEPHYR_MIPI_SYS_T_MODULE
	bool
	default y
menu "nrf_wifi (/workspace/modules/lib/nrf_wifi)"
osource "$(ZEPHYR_NRF_WIFI_KCONFIG)"
config ZEPHYR_NRF_WIFI_MODULE
	bool
	default y

config ZEPHYR_NRF_WIFI_MODULE_BLOBS
	bool
endmenu
config ZEPHYR_OPEN_AMP_MODULE
	bool
	default y
menu "percepio (/workspace/modules/debug/percepio)"
osource "/workspace/modules/debug/percepio/zephyr/Kconfig"
config ZEPHYR_PERCEPIO_MODULE
	bool
	default y
endmenu
menu "picolibc (/workspace/modules/lib/picolibc)"
osource "/workspace/modules/lib/picolibc/zephyr/Kconfig"
config ZEPHYR_PICOLIBC_MODULE
	bool
	default y
endmenu
menu "segger (/workspace/modules/debug/segger)"
osource "$(ZEPHYR_SEGGER_KCONFIG)"
config ZEPHYR_SEGGER_MODULE
	bool
	default y
endmenu
config ZEPHYR_TINYCRYPT_MODULE
	bool
	default y
menu "trusted-firmware-a (/workspace/modules/tee/tf-a/trusted-firmware-a)"
osource "$(ZEPHYR_TRUSTED_FIRMWARE_A_KCONFIG)"
config ZEPHYR_TRUSTED_FIRMWARE_A_MODULE
	bool
	default y
endmenu
menu "uoscore-uedhoc (/workspace/modules/lib/uoscore-uedhoc)"
osource "$(ZEPHYR_UOSCORE_UEDHOC_KCONFIG)"
config ZEPHYR_UOSCORE_UEDHOC_MODULE
	bool
	default y
endmenu
menu "zcbor (/workspace/modules/lib/zcbor)"
osource "$(ZEPHYR_ZCBOR_KCONFIG)"
config ZEPHYR_ZCBOR_MODULE
	bool
	default y
endmenu
menu "module (/workspace/zmk/app/module)"
osource "/workspace/zmk/app/module/Kconfig"
config ZEPHYR_MODULE_MODULE
	bool
	default y
endmenu
config ZEPHYR_KEYMAP_MODULE_MODULE
	bool
	default y
config ZEPHYR_NRF_HW_MODELS_MODULE
	bool
	default y
```

## zmk-workspace/build/cradio_right/Kconfig/Kconfig.shield
```kconfig
osource "/workspace/zmk/app/module/boards/shields/*/Kconfig.shield"
osource "/workspace/zmk/app/boards/shields/*/Kconfig.shield"
```

## zmk-workspace/build/cradio_right/Kconfig/boards/Kconfig.nice_nano
```kconfig
# Load board Kconfig descriptions.
osource "/workspace/zmk/app/module/boards/nicekeyboards/nice_nano/Kconfig.nice_nano"
osource "/workspace/zmk/app/boards/nicekeyboards/nice_nano/Kconfig.nice_nano"
```

## zmk-workspace/build/cradio_right/Kconfig/soc/Kconfig
```kconfig
# Load Zephyr SoC Kconfig descriptions.
osource "/workspace/zephyr/soc/xlnx/zynqmp/Kconfig"
osource "/workspace/zephyr/soc/xlnx/zynq7000/Kconfig"
osource "/workspace/zephyr/soc/xen/Kconfig"
osource "/workspace/zephyr/soc/wch/ch32v/Kconfig"
osource "/workspace/zephyr/soc/ti/simplelink/Kconfig"
osource "/workspace/zephyr/soc/ti/lm3s6965/Kconfig"
osource "/workspace/zephyr/soc/ti/k3/Kconfig"
osource "/workspace/zephyr/soc/telink/tlsr/Kconfig"
osource "/workspace/zephyr/soc/starfive/jh71xx/Kconfig"
osource "/workspace/zephyr/soc/st/stm32/Kconfig"
osource "/workspace/zephyr/soc/snps/qemu_arc/Kconfig"
osource "/workspace/zephyr/soc/snps/nsim/arc_v/Kconfig"
osource "/workspace/zephyr/soc/snps/nsim/arc_classic/Kconfig"
osource "/workspace/zephyr/soc/snps/hsdk4xd/Kconfig"
osource "/workspace/zephyr/soc/snps/hsdk/Kconfig"
osource "/workspace/zephyr/soc/snps/emsk/Kconfig"
osource "/workspace/zephyr/soc/snps/emsdp/Kconfig"
osource "/workspace/zephyr/soc/snps/arc_iot/Kconfig"
osource "/workspace/zephyr/soc/silabs/Kconfig"
osource "/workspace/zephyr/soc/sifive/sifive_freedom/Kconfig"
osource "/workspace/zephyr/soc/sensry/Kconfig"
osource "/workspace/zephyr/soc/rockchip/Kconfig"
osource "/workspace/zephyr/soc/renode/riscv_virtual/Kconfig"
osource "/workspace/zephyr/soc/renode/cortex_r8_virtual/Kconfig"
osource "/workspace/zephyr/soc/renesas/smartbond/Kconfig"
osource "/workspace/zephyr/soc/renesas/rzt2m/Kconfig"
osource "/workspace/zephyr/soc/renesas/rz/Kconfig"
osource "/workspace/zephyr/soc/renesas/rcar/Kconfig"
osource "/workspace/zephyr/soc/renesas/ra/Kconfig"
osource "/workspace/zephyr/soc/realtek/ec/Kconfig"
osource "/workspace/zephyr/soc/raspberrypi/rpi_pico/Kconfig"
osource "/workspace/zephyr/soc/quicklogic/eos_s3/Kconfig"
osource "/workspace/zephyr/soc/qemu/virt_riscv/Kconfig"
osource "/workspace/zephyr/soc/qemu/malta/Kconfig"
osource "/workspace/zephyr/soc/openisa/rv32m1/Kconfig"
osource "/workspace/zephyr/soc/nxp/s32/Kconfig"
osource "/workspace/zephyr/soc/nxp/rw/Kconfig"
osource "/workspace/zephyr/soc/nxp/mcx/Kconfig"
osource "/workspace/zephyr/soc/nxp/lpc/Kconfig"
osource "/workspace/zephyr/soc/nxp/layerscape/Kconfig"
osource "/workspace/zephyr/soc/nxp/kinetis/Kconfig"
osource "/workspace/zephyr/soc/nxp/imxrt/Kconfig"
osource "/workspace/zephyr/soc/nxp/imx/Kconfig"
osource "/workspace/zephyr/soc/nuvoton/numicro/Kconfig"
osource "/workspace/zephyr/soc/nuvoton/numaker/Kconfig"
osource "/workspace/zephyr/soc/nuvoton/npcx/Kconfig"
osource "/workspace/zephyr/soc/nuvoton/npcm/Kconfig"
osource "/workspace/zephyr/soc/nordic/Kconfig"
osource "/workspace/zephyr/soc/neorv32/Kconfig"
osource "/workspace/zephyr/soc/native/inf_clock/Kconfig"
osource "/workspace/zephyr/soc/microchip/miv/Kconfig"
osource "/workspace/zephyr/soc/microchip/mec/Kconfig"
osource "/workspace/zephyr/soc/mediatek/mt8xxx/Kconfig"
osource "/workspace/zephyr/soc/lowrisc/opentitan/Kconfig"
osource "/workspace/zephyr/soc/litex/litex_vexriscv/Kconfig"
osource "/workspace/zephyr/soc/ite/ec/Kconfig"
osource "/workspace/zephyr/soc/intel/raptor_lake/Kconfig"
osource "/workspace/zephyr/soc/intel/lakemont/Kconfig"
osource "/workspace/zephyr/soc/intel/intel_socfpga_std/Kconfig"
osource "/workspace/zephyr/soc/intel/intel_socfpga/Kconfig"
osource "/workspace/zephyr/soc/intel/intel_niosv/Kconfig"
osource "/workspace/zephyr/soc/intel/intel_ish/Kconfig"
osource "/workspace/zephyr/soc/intel/intel_adsp/Kconfig"
osource "/workspace/zephyr/soc/intel/elkhart_lake/Kconfig"
osource "/workspace/zephyr/soc/intel/atom/Kconfig"
osource "/workspace/zephyr/soc/intel/apollo_lake/Kconfig"
osource "/workspace/zephyr/soc/intel/alder_lake/Kconfig"
osource "/workspace/zephyr/soc/infineon/cat3/Kconfig"
osource "/workspace/zephyr/soc/infineon/cat1b/Kconfig"
osource "/workspace/zephyr/soc/infineon/cat1a/Kconfig"
osource "/workspace/zephyr/soc/gd/gd32/Kconfig"
osource "/workspace/zephyr/soc/gaisler/leon3/Kconfig"
osource "/workspace/zephyr/soc/gaisler/gr716a/Kconfig"
osource "/workspace/zephyr/soc/espressif/Kconfig"
osource "/workspace/zephyr/soc/ene/kb1200/Kconfig"
osource "/workspace/zephyr/soc/efinix/sapphire/Kconfig"
osource "/workspace/zephyr/soc/cdns/xtensa_sample_controller/Kconfig"
osource "/workspace/zephyr/soc/cdns/sample_controller32/Kconfig"
osource "/workspace/zephyr/soc/cdns/dc233c/Kconfig"
osource "/workspace/zephyr/soc/brcm/bcmvk/Kconfig"
osource "/workspace/zephyr/soc/brcm/bcm2712/Kconfig"
osource "/workspace/zephyr/soc/brcm/bcm2711/Kconfig"
osource "/workspace/zephyr/soc/atmel/sam0/Kconfig"
osource "/workspace/zephyr/soc/atmel/sam/Kconfig"
osource "/workspace/zephyr/soc/aspeed/Kconfig"
osource "/workspace/zephyr/soc/arm/Kconfig"
osource "/workspace/zephyr/soc/arm/beetle/Kconfig"
osource "/workspace/zephyr/soc/antmicro/myra/Kconfig"
osource "/workspace/zephyr/soc/andestech/Kconfig"
osource "/workspace/zephyr/soc/amd/acp_6_0/Kconfig"
osource "/workspace/zephyr/soc/ambiq/Kconfig"
osource "/workspace/zephyr/soc/altr/zephyr_nios2f/Kconfig"
osource "/workspace/zephyr/soc/altr/qemu_nios2/Kconfig"
osource "/workspace/zephyr/soc/adi/max32/Kconfig"
```
