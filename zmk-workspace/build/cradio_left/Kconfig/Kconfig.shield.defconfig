## zmk-workspace/build/cradio_right/Kconfig/soc/Kconfig.soc
```kconfig
# Load SoC Kconfig descriptions.
osource "/workspace/zephyr/soc/xlnx/zynqmp/Kconfig.soc"
osource "/workspace/zephyr/soc/xlnx/zynq7000/Kconfig.soc"
osource "/workspace/zephyr/soc/xen/Kconfig.soc"
osource "/workspace/zephyr/soc/wch/ch32v/Kconfig.soc"
osource "/workspace/zephyr/soc/ti/simplelink/Kconfig.soc"
osource "/workspace/zephyr/soc/ti/lm3s6965/Kconfig.soc"
osource "/workspace/zephyr/soc/ti/k3/Kconfig.soc"
osource "/workspace/zephyr/soc/telink/tlsr/Kconfig.soc"
osource "/workspace/zephyr/soc/starfive/jh71xx/Kconfig.soc"
osource "/workspace/zephyr/soc/st/stm32/Kconfig.soc"
osource "/workspace/zephyr/soc/snps/qemu_arc/Kconfig.soc"
osource "/workspace/zephyr/soc/snps/nsim/arc_v/Kconfig.soc"
osource "/workspace/zephyr/soc/snps/nsim/arc_classic/Kconfig.soc"
osource "/workspace/zephyr/soc/snps/hsdk4xd/Kconfig.soc"
osource "/workspace/zephyr/soc/snps/hsdk/Kconfig.soc"
osource "/workspace/zephyr/soc/snps/emsk/Kconfig.soc"
osource "/workspace/zephyr/soc/snps/emsdp/Kconfig.soc"
osource "/workspace/zephyr/soc/snps/arc_iot/Kconfig.soc"
osource "/workspace/zephyr/soc/silabs/Kconfig.soc"
osource "/workspace/zephyr/soc/sifive/sifive_freedom/Kconfig.soc"
osource "/workspace/zephyr/soc/sensry/Kconfig.soc"
osource "/workspace/zephyr/soc/rockchip/Kconfig.soc"
osource "/workspace/zephyr/soc/renode/riscv_virtual/Kconfig.soc"
osource "/workspace/zephyr/soc/renode/cortex_r8_virtual/Kconfig.soc"
osource "/workspace/zephyr/soc/renesas/smartbond/Kconfig.soc"
osource "/workspace/zephyr/soc/renesas/rzt2m/Kconfig.soc"
osource "/workspace/zephyr/soc/renesas/rz/Kconfig.soc"
osource "/workspace/zephyr/soc/renesas/rcar/Kconfig.soc"
osource "/workspace/zephyr/soc/renesas/ra/Kconfig.soc"
osource "/workspace/zephyr/soc/realtek/ec/Kconfig.soc"
osource "/workspace/zephyr/soc/raspberrypi/rpi_pico/Kconfig.soc"
osource "/workspace/zephyr/soc/quicklogic/eos_s3/Kconfig.soc"
osource "/workspace/zephyr/soc/qemu/virt_riscv/Kconfig.soc"
osource "/workspace/zephyr/soc/qemu/malta/Kconfig.soc"
osource "/workspace/zephyr/soc/openisa/rv32m1/Kconfig.soc"
osource "/workspace/zephyr/soc/nxp/s32/Kconfig.soc"
osource "/workspace/zephyr/soc/nxp/rw/Kconfig.soc"
osource "/workspace/zephyr/soc/nxp/mcx/Kconfig.soc"
osource "/workspace/zephyr/soc/nxp/lpc/Kconfig.soc"
osource "/workspace/zephyr/soc/nxp/layerscape/Kconfig.soc"
osource "/workspace/zephyr/soc/nxp/kinetis/Kconfig.soc"
osource "/workspace/zephyr/soc/nxp/imxrt/Kconfig.soc"
osource "/workspace/zephyr/soc/nxp/imx/Kconfig.soc"
osource "/workspace/zephyr/soc/nuvoton/numicro/Kconfig.soc"
osource "/workspace/zephyr/soc/nuvoton/numaker/Kconfig.soc"
osource "/workspace/zephyr/soc/nuvoton/npcx/Kconfig.soc"
osource "/workspace/zephyr/soc/nuvoton/npcm/Kconfig.soc"
osource "/workspace/zephyr/soc/nordic/Kconfig.soc"
osource "/workspace/zephyr/soc/neorv32/Kconfig.soc"
osource "/workspace/zephyr/soc/native/inf_clock/Kconfig.soc"
osource "/workspace/zephyr/soc/microchip/miv/Kconfig.soc"
osource "/workspace/zephyr/soc/microchip/mec/Kconfig.soc"
osource "/workspace/zephyr/soc/mediatek/mt8xxx/Kconfig.soc"
osource "/workspace/zephyr/soc/lowrisc/opentitan/Kconfig.soc"
osource "/workspace/zephyr/soc/litex/litex_vexriscv/Kconfig.soc"
osource "/workspace/zephyr/soc/ite/ec/Kconfig.soc"
osource "/workspace/zephyr/soc/intel/raptor_lake/Kconfig.soc"
osource "/workspace/zephyr/soc/intel/lakemont/Kconfig.soc"
osource "/workspace/zephyr/soc/intel/intel_socfpga_std/Kconfig.soc"
osource "/workspace/zephyr/soc/intel/intel_socfpga/Kconfig.soc"
osource "/workspace/zephyr/soc/intel/intel_niosv/Kconfig.soc"
osource "/workspace/zephyr/soc/intel/intel_ish/Kconfig.soc"
osource "/workspace/zephyr/soc/intel/intel_adsp/Kconfig.soc"
osource "/workspace/zephyr/soc/intel/elkhart_lake/Kconfig.soc"
osource "/workspace/zephyr/soc/intel/atom/Kconfig.soc"
osource "/workspace/zephyr/soc/intel/apollo_lake/Kconfig.soc"
osource "/workspace/zephyr/soc/intel/alder_lake/Kconfig.soc"
osource "/workspace/zephyr/soc/infineon/cat3/Kconfig.soc"
osource "/workspace/zephyr/soc/infineon/cat1b/Kconfig.soc"
osource "/workspace/zephyr/soc/infineon/cat1a/Kconfig.soc"
osource "/workspace/zephyr/soc/gd/gd32/Kconfig.soc"
osource "/workspace/zephyr/soc/gaisler/leon3/Kconfig.soc"
osource "/workspace/zephyr/soc/gaisler/gr716a/Kconfig.soc"
osource "/workspace/zephyr/soc/espressif/Kconfig.soc"
osource "/workspace/zephyr/soc/ene/kb1200/Kconfig.soc"
osource "/workspace/zephyr/soc/efinix/sapphire/Kconfig.soc"
osource "/workspace/zephyr/soc/cdns/xtensa_sample_controller/Kconfig.soc"
osource "/workspace/zephyr/soc/cdns/sample_controller32/Kconfig.soc"
osource "/workspace/zephyr/soc/cdns/dc233c/Kconfig.soc"
osource "/workspace/zephyr/soc/brcm/bcmvk/Kconfig.soc"
osource "/workspace/zephyr/soc/brcm/bcm2712/Kconfig.soc"
osource "/workspace/zephyr/soc/brcm/bcm2711/Kconfig.soc"
osource "/workspace/zephyr/soc/atmel/sam0/Kconfig.soc"
osource "/workspace/zephyr/soc/atmel/sam/Kconfig.soc"
osource "/workspace/zephyr/soc/aspeed/Kconfig.soc"
osource "/workspace/zephyr/soc/arm/Kconfig.soc"
osource "/workspace/zephyr/soc/arm/beetle/Kconfig.soc"
osource "/workspace/zephyr/soc/antmicro/myra/Kconfig.soc"
osource "/workspace/zephyr/soc/andestech/Kconfig.soc"
osource "/workspace/zephyr/soc/amd/acp_6_0/Kconfig.soc"
osource "/workspace/zephyr/soc/ambiq/Kconfig.soc"
osource "/workspace/zephyr/soc/altr/zephyr_nios2f/Kconfig.soc"
osource "/workspace/zephyr/soc/altr/qemu_nios2/Kconfig.soc"
osource "/workspace/zephyr/soc/adi/max32/Kconfig.soc"
```
